## build/Kconfig/Kconfig.modules
```kconfig
menu "nanopb (/Users/ferro/keyboards/zmk-dactyl-mini/modules/lib/nanopb)"
osource "$(ZEPHYR_NANOPB_KCONFIG)"
config ZEPHYR_NANOPB_MODULE
	bool
	default y
endmenu
menu "acpica (/Users/ferro/keyboards/zmk-dactyl-mini/modules/lib/acpica)"
osource "$(ZEPHYR_ACPICA_KCONFIG)"
config ZEPHYR_ACPICA_MODULE
	bool
	default y
endmenu
menu "canopennode (/Users/ferro/keyboards/zmk-dactyl-mini/modules/lib/canopennode)"
osource "$(ZEPHYR_CANOPENNODE_KCONFIG)"
config ZEPHYR_CANOPENNODE_MODULE
	bool
	default y
endmenu
menu "cmsis (/Users/ferro/keyboards/zmk-dactyl-mini/modules/hal/cmsis)"
osource "$(ZEPHYR_CMSIS_KCONFIG)"
config ZEPHYR_CMSIS_MODULE
	bool
	default y
endmenu
menu "cmsis-dsp (/Users/ferro/keyboards/zmk-dactyl-mini/modules/lib/cmsis-dsp)"
osource "$(ZEPHYR_CMSIS_DSP_KCONFIG)"
config ZEPHYR_CMSIS_DSP_MODULE
	bool
	default y
endmenu
menu "cmsis-nn (/Users/ferro/keyboards/zmk-dactyl-mini/modules/lib/cmsis-nn)"
osource "$(ZEPHYR_CMSIS_NN_KCONFIG)"
config ZEPHYR_CMSIS_NN_MODULE
	bool
	default y
endmenu
menu "fatfs (/Users/ferro/keyboards/zmk-dactyl-mini/modules/fs/fatfs)"
osource "$(ZEPHYR_FATFS_KCONFIG)"
config ZEPHYR_FATFS_MODULE
	bool
	default y
endmenu
menu "hal_ambiq (/Users/ferro/keyboards/zmk-dactyl-mini/modules/hal/ambiq)"
osource "$(ZEPHYR_HAL_AMBIQ_KCONFIG)"
config ZEPHYR_HAL_AMBIQ_MODULE
	bool
	default y
endmenu
menu "hal_espressif (/Users/ferro/keyboards/zmk-dactyl-mini/modules/hal/espressif)"
osource "/Users/ferro/keyboards/zmk-dactyl-mini/modules/hal/espressif/zephyr/Kconfig"
config ZEPHYR_HAL_ESPRESSIF_MODULE
	bool
	default y
endmenu
menu "hal_ethos_u (/Users/ferro/keyboards/zmk-dactyl-mini/modules/hal/ethos_u)"
osource "$(ZEPHYR_HAL_ETHOS_U_KCONFIG)"
config ZEPHYR_HAL_ETHOS_U_MODULE
	bool
	default y
endmenu
menu "hal_gigadevice (/Users/ferro/keyboards/zmk-dactyl-mini/modules/hal/gigadevice)"
osource "$(ZEPHYR_HAL_GIGADEVICE_KCONFIG)"
config ZEPHYR_HAL_GIGADEVICE_MODULE
	bool
	default y
endmenu
menu "hal_nordic (/Users/ferro/keyboards/zmk-dactyl-mini/modules/hal/nordic)"
osource "$(ZEPHYR_HAL_NORDIC_KCONFIG)"
config ZEPHYR_HAL_NORDIC_MODULE
	bool
	default y
endmenu
menu "hal_rpi_pico (/Users/ferro/keyboards/zmk-dactyl-mini/modules/hal/rpi_pico)"
osource "$(ZEPHYR_HAL_RPI_PICO_KCONFIG)"
config ZEPHYR_HAL_RPI_PICO_MODULE
	bool
	default y
endmenu
menu "hal_telink (/Users/ferro/keyboards/zmk-dactyl-mini/modules/hal/telink)"
osource "/Users/ferro/keyboards/zmk-dactyl-mini/modules/hal/telink/Kconfig"
config ZEPHYR_HAL_TELINK_MODULE
	bool
	default y
endmenu
menu "liblc3 (/Users/ferro/keyboards/zmk-dactyl-mini/modules/lib/liblc3)"
osource "$(ZEPHYR_LIBLC3_KCONFIG)"
config ZEPHYR_LIBLC3_MODULE
	bool
	default y
endmenu
menu "littlefs (/Users/ferro/keyboards/zmk-dactyl-mini/modules/fs/littlefs)"
osource "$(ZEPHYR_LITTLEFS_KCONFIG)"
config ZEPHYR_LITTLEFS_MODULE
	bool
	default y
endmenu
menu "lvgl (/Users/ferro/keyboards/zmk-dactyl-mini/modules/lib/gui/lvgl)"
osource "/Users/ferro/keyboards/zmk-dactyl-mini/modules/lib/gui/lvgl/Kconfig"
config ZEPHYR_LVGL_MODULE
	bool
	default y
endmenu
menu "mbedtls (/Users/ferro/keyboards/zmk-dactyl-mini/modules/crypto/mbedtls)"
osource "$(ZEPHYR_MBEDTLS_KCONFIG)"
config ZEPHYR_MBEDTLS_MODULE
	bool
	default y
endmenu
menu "percepio (/Users/ferro/keyboards/zmk-dactyl-mini/modules/debug/percepio)"
osource "/Users/ferro/keyboards/zmk-dactyl-mini/modules/debug/percepio/zephyr/Kconfig"
config ZEPHYR_PERCEPIO_MODULE
	bool
	default y
endmenu
menu "picolibc (/Users/ferro/keyboards/zmk-dactyl-mini/modules/lib/picolibc)"
osource "/Users/ferro/keyboards/zmk-dactyl-mini/modules/lib/picolibc/zephyr/Kconfig"
config ZEPHYR_PICOLIBC_MODULE
	bool
	default y
endmenu
menu "segger (/Users/ferro/keyboards/zmk-dactyl-mini/modules/debug/segger)"
osource "$(ZEPHYR_SEGGER_KCONFIG)"
config ZEPHYR_SEGGER_MODULE
	bool
	default y
endmenu
menu "trusted-firmware-a (/Users/ferro/keyboards/zmk-dactyl-mini/modules/tee/tf-a/trusted-firmware-a)"
osource "$(ZEPHYR_TRUSTED_FIRMWARE_A_KCONFIG)"
config ZEPHYR_TRUSTED_FIRMWARE_A_MODULE
	bool
	default y
endmenu
menu "uoscore-uedhoc (/Users/ferro/keyboards/zmk-dactyl-mini/modules/lib/uoscore-uedhoc)"
osource "$(ZEPHYR_UOSCORE_UEDHOC_KCONFIG)"
config ZEPHYR_UOSCORE_UEDHOC_MODULE
	bool
	default y
endmenu
menu "zcbor (/Users/ferro/keyboards/zmk-dactyl-mini/modules/lib/zcbor)"
osource "$(ZEPHYR_ZCBOR_KCONFIG)"
config ZEPHYR_ZCBOR_MODULE
	bool
	default y
endmenu
menu "module (/Users/ferro/keyboards/zmk-dactyl-mini/zmk/app/module)"
osource "/Users/ferro/keyboards/zmk-dactyl-mini/zmk/app/module/Kconfig"
config ZEPHYR_MODULE_MODULE
	bool
	default y
endmenu
```

## build/Kconfig/Kconfig.shield
```kconfig
osource "/Users/ferro/keyboards/zmk-dactyl-mini/zmk/app/boards/shields/*/Kconfig.shield"
osource "/Users/ferro/keyboards/zmk-dactyl-mini/config/boards/shields/*/Kconfig.shield"
```

## build_right/Kconfig/Kconfig.shield.defconfig
```kconfig
osource "/Users/ferro/keyboards/zmk-dactyl-mini/zmk/app/boards/shields/*/Kconfig.defconfig"
osource "/Users/ferro/keyboards/zmk-dactyl-mini/config/boards/shields/*/Kconfig.defconfig"
```
